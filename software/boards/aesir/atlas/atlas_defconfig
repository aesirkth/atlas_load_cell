## software/boards/aesir/atlas/atlas_defconfig
```kconfig
# SPDX-License-Identifier: Apache-2.0

# enable usb cdc
CONFIG_USB_DEVICE_STACK=y
CONFIG_USB_DEVICE_INITIALIZE_AT_BOOT=y
CONFIG_USB_DEVICE_VID=0x6969
CONFIG_USB_DEVICE_PID=0x6969
CONFIG_USB_CDC_ACM=y

# enable serial over usb
CONFIG_SERIAL=y

# enable GPIO
CONFIG_GPIO=y

# console
CONFIG_CONSOLE=y
CONFIG_UART_CONSOLE=y

# Enable MPU
CONFIG_ARM_MPU=y

# Enable HW stack protection
CONFIG_HW_STACK_PROTECTION=y
```

## software/boards/aesir/atlas/board.yml
```yaml
board:
  name: atlas
  full_name: atlas load cell
  vendor: aesir
  socs:
    - name: stm32u575xx
```
